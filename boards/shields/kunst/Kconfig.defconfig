## boards/shields/kunst/Kconfig.defconfig
```kconfig
# Copyright (c) 2020 The ZMK Contributors
# SPDX-License-Identifier: MIT

if SHIELD_KUNST_LEFT

config ZMK_KEYBOARD_NAME
	default "The Kunst"

config ZMK_SPLIT_ROLE_CENTRAL
	default y

endif

config ZMK_BLE
	default y

config ZMK_USB
	default y

if SHIELD_KUNST_LEFT || SHIELD_KUNST_RIGHT

config ZMK_SPLIT
	default y

endif
```

## boards/shields/kunst/Kconfig.shield
```kconfig
# Copyright (c) 2020 The ZMK Contributors
# SPDX-License-Identifier: MIT

config SHIELD_KUNST_DONGLE_LEFT
	def_bool $(shields_list_contains,kunst_dongle_left)

config SHIELD_KUNST_DONGLE_RIGHT
	def_bool $(shields_list_contains,kunst_dongle_right)

config SHIELD_KUNST_DONGLE
	def_bool $(shields_list_contains,kunst_dongle)

config SHIELD_KUNST_NORM_LEFT
	def_bool $(shields_list_contains,kunst_norm_left)

config SHIELD_KUNST_NORM_RIGHT
	def_bool $(shields_list_contains,kunst_norm_right)
```

## config/boards/shields/kunst/Kconfig.shield
```kconfig
# Copyright (c) 2020 The ZMK Contributors
# SPDX-License-Identifier: MIT

config SHIELD_KUNST_LEFT
	def_bool $(shields_list_contains,kunst_left)

config SHIELD_KUNST_RIGHT
	def_bool $(shields_list_contains,kunst_right)
```
